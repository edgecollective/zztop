## firmware/boards/electrosmith/daisy_seed/Kconfig.daisy_seed
```kconfig
# Copyright (c) 2026 Craig Versek
# SPDX-License-Identifier: Apache-2.0

config BOARD_DAISY_SEED
	select SOC_STM32H750XX
```

## firmware/boards/electrosmith/daisy_seed/board.yml
```yaml
board:
  name: daisy_seed
  full_name: Daisy Seed Rev7
  vendor: electrosmith
  socs:
    - name: stm32h750xx
```
